## conf/machine/vexpress-qemu.conf
```bitbake
#@TYPE: Machine
#@NAME: vexpress-qemu

#@DESCRIPTION: Machine configuration for QEMU running vexpress


MACHINE_EXTRA_RRECOMMENDS = " kernel-modules kernel-devicetree"

IMAGE_INSTALL_append = " kernel-image kernel-devicetree u-boot u-boot-fw-utils mender"

EXTRA_IMAGEDEPENDS += "u-boot"

require conf/machine/include/qemu.inc
include conf/machine/include/arm/arch-armv5-dsp.inc

IMAGE_CLASSES += "sdimg"
IMAGE_FSTYPES = "tar.gz ext3 sdimg"

SERIAL_CONSOLE = "115200 ttyAMA0"

PREFERRED_PROVIDER_virtual/kernel ?= "linux-yocto"


KERNEL_IMAGETYPE = "zImage"
KERNEL_DEVICETREE = "vexpress-v2p-ca9.dtb"
KERNEL_EXTRA_ARGS += "LOADADDR=${UBOOT_ENTRYPOINT}"

UBOOT_SUFFIX = "bin"
UBOOT_MACHINE = "vexpress_ca9x4_config"
UBOOT_ENTRYPOINT = "0x60800000"
UBOOT_LOADADDRESS = "0x60800000"

UBOOT_ELF ?= "u-boot"

# Needed to skip particular QA checks that don't apply to U-boot's binary.
INSANE_SKIP_u-boot += "ldflags textrel"

#MACHINE_FEATURES = "usbgadget usbhost vfat alsa"

IMAGE_BOOT_FILES ?= "u-boot.${UBOOT_SUFFIX}"
```

## meta-mender-beaglebone/conf/layer.conf
```bitbake
# Board specific layer configuration for meta-mender
# Copyright 2016 Mender Software AS

# We have a conf and classes directory, add to BBPATH
BBPATH .= ":${LAYERDIR}"

# We have recipes-* directories, add to BBFILES
BBFILES += "${LAYERDIR}/recipes-*/*/*.bb \
	${LAYERDIR}/recipes-*/*/*.bbappend"

BBFILE_COLLECTIONS += "mender-beaglebone"
BBFILE_PATTERN_mender-beaglebone = "^${LAYERDIR}/"
BBFILE_PRIORITY_mender-beaglebone = "6"
```

## meta-mender-commercial/conf/layer.conf
```bitbake
# Layer configuration for meta-mender
# Copyright 2019 Northern.tech AS

# We have a conf and classes directory, add to BBPATH
BBPATH .= ":${LAYERDIR}"

# We have recipes-* directories, add to BBFILES
# Currently only bb files, no bbappends.
BBFILES += "${LAYERDIR}/recipes-*/*/*.bb"

BBFILE_COLLECTIONS += "mender-commercial"
BBFILE_PATTERN_mender-commercial = "^${LAYERDIR}/"
BBFILE_PRIORITY_mender-commercial = "6"

LAYERSERIES_COMPAT_mender-commercial = "dunfell"
LAYERDEPENDS_mender-commercial = "mender"

LICENSE_PATH_append := " ${LAYERDIR}/files/licenses"
```

## meta-mender-core/conf/layer.conf
```bitbake
# Layer configuration for meta-mender
# Copyright 2017 Northern.tech AS

# We have a conf and classes directory, add to BBPATH
BBPATH .= ":${LAYERDIR}"

# Save layerdir for use in functions outside .conf scope
LAYERDIR_MENDER := "${LAYERDIR}"

# We have recipes-* directories, add to BBFILES
BBFILES += "${LAYERDIR}/recipes-*/*/*.bb \
	${LAYERDIR}/recipes-*/*/*.bbappend"

BBFILE_COLLECTIONS += "mender"
BBFILE_PATTERN_mender = "^${LAYERDIR}/"
BBFILE_PRIORITY_mender = "6"

INHERIT += "mender-maybe-setup"

LAYERSERIES_COMPAT_mender = "scarthgap"
LAYERDEPENDS_mender = "core"

# See https://northerntech.atlassian.net/browse/MEN-3513 and
# https://northerntech.atlassian.net/browse/MEN-3781 and
# https://northerntech.atlassian.net/browse/MEN-3912.
#
# `has_journal` interferes with the checksum of the image when viewed from the block device. Oddly
# enough it is not present on disk, IOW, when the image is mounted readonly, the physical checksum
# on disk, and the checksum of the corresponding block device, are not the same. Work around this by
# disabling the journal for read-only filesystems, where it is useless anyway.
EXTRA_IMAGECMD:ext4:append = "${@bb.utils.contains('IMAGE_FEATURES', 'read-only-rootfs', ' -O ^has_journal', '', d)}"
```

## meta-mender-demo/conf/layer.conf
```bitbake
# Layer configuration for meta-mender
# Copyright 2022 Northern.tech AS

# We have a conf and classes directory, add to BBPATH
BBPATH .= ":${LAYERDIR}"

# We have recipes-* directories, add to BBFILES
BBFILES += "${LAYERDIR}/recipes-*/*/*.bb \
	${LAYERDIR}/recipes-*/*/*.bbappend"

BBFILES_DYNAMIC += "\
  mender-commercial:${LAYERDIR}/mender-commercial/mender-monitor/mender-monitor*.bbappend \
  mender-commercial:${LAYERDIR}/mender-commercial/mender-gateway/mender-gateway*.bbappend \
  mender-commercial:${LAYERDIR}/mender-commercial/mender-orchestrator/mender-orchestrator*.bbappend \
  mender-commercial:${LAYERDIR}/mender-commercial/mender-orchestrator-support/mender-orchestrator-support*.bbappend \
"

BBFILE_COLLECTIONS += "mender-demo"
BBFILE_PATTERN_mender-demo = "^${LAYERDIR}/"
BBFILE_PRIORITY_mender-demo = "10"

LAYERSERIES_COMPAT_mender-demo = "walnascar"
LAYERDEPENDS_mender-demo = "mender openembedded-layer"
```

## meta-mender-dragonboard-410c/conf/layer.conf
```bitbake
# Board specific layer configuration for meta-mender

# We have a conf and classes directory, add to BBPATH
BBPATH .= ":${LAYERDIR}"

# We have recipes-* directories, add to BBFILES
BBFILES += "${LAYERDIR}/recipes-*/*/*.bb \
	${LAYERDIR}/recipes-*/*/*.bbappend"

BBFILE_COLLECTIONS += "mender-dragonboard-410c"
BBFILE_PATTERN_mender-dragonboard-410c = "^${LAYERDIR}/"
BBFILE_PRIORITY_mender-dragonboard-410c = "10"
```

## meta-mender-extended/conf/layer.conf
```bitbake
# Layer configuration for meta-mender
# Copyright 2025 Northern.tech AS

# We have a conf and classes directory, add to BBPATH
BBPATH .= ":${LAYERDIR}"

# We have recipes-* directories, add to BBFILES
BBFILES += "${LAYERDIR}/recipes-*/*/*.bb \
	${LAYERDIR}/recipes-*/*/*.bbappend"

BBFILE_COLLECTIONS += "mender-extended"
BBFILE_PATTERN_mender-extended = "^${LAYERDIR}/"
BBFILE_PRIORITY_mender-extended = "10"

LAYERSERIES_COMPAT_mender-extended = "scarthgap"
LAYERDEPENDS_mender-extended = "mender virtualization-layer"
```

## meta-mender-orangepi/conf/layer.conf
```bitbake
# Board specific layer configuration for meta-mender
# Copyright 2018 Marek Belisko

# We have a conf and classes directory, add to BBPATH
BBPATH .= ":${LAYERDIR}"

# We have recipes-* directories, add to BBFILES
BBFILES += "${LAYERDIR}/recipes-*/*/*.bb \
	${LAYERDIR}/recipes-*/*/*.bbappend"

BBFILE_COLLECTIONS += "mender-orangepi"
BBFILE_PATTERN_mender-orangepi = "^${LAYERDIR}/"
BBFILE_PRIORITY_mender-orangepi = "10"

LAYERSERIES_COMPAT_mender-orangepi = "thud"
```

## meta-mender-overo/conf/layer.conf
```bitbake
# Board specific layer configuration for meta-mender
# Copyright 2018 Northern.tech AS

# We have a conf and classes directory, add to BBPATH
BBPATH .= ":${LAYERDIR}"

# We have recipes-* directories, add to BBFILES
BBFILES += "${LAYERDIR}/recipes-*/*/*.bb \
	${LAYERDIR}/recipes-*/*/*.bbappend"

BBFILE_COLLECTIONS += "mender-overo"
BBFILE_PATTERN_mender-overo = "^${LAYERDIR}/"
BBFILE_PRIORITY_mender-overo = "9"
```

## meta-mender-qemu/conf/layer.conf
```bitbake
# Board specific layer configuration for meta-mender
# Copyright 2017 Northern.tech AS

# We have a conf and classes directory, add to BBPATH
BBPATH .= ":${LAYERDIR}"

# We have recipes-* directories, add to BBFILES
BBFILES += "${LAYERDIR}/recipes-*/*/*.bb \
	${LAYERDIR}/recipes-*/*/*.bbappend"

BBFILE_COLLECTIONS += "mender-qemu"
BBFILE_PATTERN_mender-qemu = "^${LAYERDIR}/"
BBFILE_PRIORITY_mender-qemu = "6"

LAYERSERIES_COMPAT_mender-qemu = "whinlatter"
LAYERDEPENDS_mender-qemu = "mender"

MENDER_EFI_LOADER:mender-image-uefi:qemux86 = "ovmf"
MENDER_EFI_LOADER:mender-image-uefi:qemux86-64 = "ovmf"

MENDER_STORAGE_DEVICE_DEFAULT:qemux86-64:mender-update-install = "/dev/sda"
MENDER_STORAGE_DEVICE_DEFAULT:qemux86:mender-update-install = "/dev/sda"

# To tell the difference from a vexpress-qemu image with only U-Boot.
MENDER_DEVICE_TYPE_DEFAULT:vexpress-qemu:mender-grub = "${MACHINE}-grub"
# To tell the difference from a qemux86-64 image with GRUB and UEFI.
MENDER_DEVICE_TYPE_DEFAULT:qemux86-64:mender-grub:mender-bios = "${MACHINE}-bios"
# To tell the difference from a qemux86-64 image with BIOS and MBR.
MENDER_DEVICE_TYPE_DEFAULT:qemux86-64:mender-grub:mender-bios:mender-image-gpt = "${MACHINE}-bios-grub-gpt"

# The rngd daemon included in this package constantly pegs the CPU at 100% for
# the first 3-7 minutes, and drastically reduces the performance in tests. We
# don't need it for most of our images, so just disable it. Our
# vexpress-qemu-flash image needs it though. For some reason the RNG source
# cannot be initialized there without it.
PACKAGE_EXCLUDE:append:mender-image = "${@' rng-tools' if d.getVar('MACHINE') != 'vexpress-qemu-flash' else ''}"

# Disable feature for compatibility with GRUB 2.04 (kirkstone)
# Recent versions of mke2fs enable the feature by default, but it renders the filesystem
# unrecognizable for older GRUB, blocking the kirkstone to scarthcap update path. See:
# * Bug report: http://savannah.gnu.org/bugs/?56897
# * Fix: https://git.savannah.gnu.org/cgit/grub.git/commit/?id=7fd5feff97c4b1f446f8fcf6d37aca0c64e7c763
# * mke2fs release notes: https://git.kernel.org/pub/scm/fs/ext2/e2fsprogs.git/tree/doc/RelNotes/v1.47.0.txt
EXTRA_IMAGECMD:ext4:append = " -O ^metadata_csum_seed"
```

## meta-mender-qemu/conf/machine/include/vexpress.inc
```bitbake
include conf/machine/include/arm/arch-armv5-dsp.inc

PREFERRED_PROVIDER_virtual/kernel ?= "linux-yocto"
PREFERRED_VERSION_linux-yocto ?= "4.1%"

SERIAL_CONSOLE = "115200 ttyAMA0"

KERNEL_IMAGETYPE = "zImage"
KERNEL_DEVICETREE = "vexpress-v2p-ca9.dtb"
KERNEL_EXTRA_ARGS += "LOADADDR=${UBOOT_ENTRYPOINT}"

UBOOT_SUFFIX = "bin"
UBOOT_MACHINE = "vexpress_ca9x4_config"
UBOOT_ENTRYPOINT = "0x60800000"
UBOOT_LOADADDRESS = "0x60800000"

UBOOT_ELF ?= "u-boot"
```

## meta-mender-qemu/conf/machine/mender-qemux86-64-bios.conf
```bitbake
# Machine definition for qemux86-64 with BIOS booting. We make this distinction
# in order to not have two machine names that are in fact incompatible.

include conf/machine/qemux86-64.conf

MACHINEOVERRIDES =. "qemux86-64:"

INHERIT += "mender-full-bios"
```

## meta-mender-qemu/conf/machine/vexpress-qemu-flash.conf
```bitbake
#@TYPE: Machine
#@NAME: vexpress-qemu

#@DESCRIPTION: Machine configuration for QEMU running vexpress with system on MTD device

require conf/machine/include/qemu.inc
require conf/machine/include/vexpress.inc

# build only vexpress-nor (used for qemu and testing)
# mender-image-ubi will append ubimg to built FSTYPES
IMAGE_FSTYPES = "vexpress-nor"

MACHINE_ESSENTIAL_EXTRA_RDEPENDS = "kernel-image kernel-devicetree"
MACHINE_ESSENTIAL_EXTRA_RRECOMMENDS += "mtd-utils mtd-utils-ubifs mtd-utils-jffs2"

MENDER_STORAGE_PEB_SIZE = "262144"

# NOTE: normally we'd pick up overrides for vexpress-qemu, disable them for now
# to avoid incorrect u-boot patches being applied (on a side note, maybe rework
# u-boot patches to be applied for any machine?)

#MACHINEOVERRIDES =. "vexpress-qemu-flash:vexpress-qemu:"

# Needed to skip particular QA checks that don't apply to U-boot's binary.
INSANE_SKIP_u-boot += "ldflags textrel"

# combined NOR flash is 128MB
MENDER_STORAGE_TOTAL_SIZE_MB = "128"
# 16MB for data partition
MENDER_DATA_PART_SIZE_MB ?= "16"

# CONFIG_MTD_CONCAT is set in U-Boot, hence nor0 and nor1 will become a single
# device named nor2.
MENDER_MTDIDS ?= "nor2=40000000.flash"

# add support for generating NOR Image files
IMAGE_CLASSES += "vexpress-nor_image"
```

## meta-mender-qemu/conf/machine/vexpress-qemu.conf
```bitbake
#@TYPE: Machine
#@NAME: vexpress-qemu

#@DESCRIPTION: Machine configuration for QEMU running vexpress with system on MMC device


MACHINE_EXTRA_RRECOMMENDS = " kernel-modules kernel-devicetree"

IMAGE_INSTALL_append = " kernel-image kernel-devicetree"

require conf/machine/include/qemu.inc
require conf/machine/include/vexpress.inc

# Needed to skip particular QA checks that don't apply to U-boot's binary.
INSANE_SKIP_u-boot += "ldflags textrel"

IMAGE_BOOT_FILES ?= "${@bb.utils.contains('DISTRO_FEATURES', 'mender-uboot', 'u-boot.${UBOOT_SUFFIX}', '', d)}"
```

## meta-mender-raspberrypi-demo/conf/layer.conf
```bitbake
# Board specific layer configuration for meta-mender
# Copyright 2018 Northern.tech AS

# We have a conf and classes directory, add to BBPATH
BBPATH .= ":${LAYERDIR}"

# We have recipes-* directories, add to BBFILES
BBFILES += "${LAYERDIR}/recipes-*/*/*.bb \
            ${LAYERDIR}/recipes-*/*/*.bbappend"

BBFILE_COLLECTIONS += "mender-raspberrypi-demo"
BBFILE_PATTERN_mender-raspberrypi-demo = "^${LAYERDIR}/"

LAYERDEPENDS_mender-raspberrypi-demo = "mender mender-demo mender-raspberrypi"

INHERIT += "rpi-demo-wifi"

LAYERSERIES_COMPAT_mender-raspberrypi-demo = "zeus"
```

## meta-mender-raspberrypi/conf/layer.conf
```bitbake
# Board specific layer configuration for meta-mender
# Copyright 2016 Mirza Krak

# We have a conf and classes directory, add to BBPATH
BBPATH .= ":${LAYERDIR}"

# We have recipes-* directories, add to BBFILES
BBFILES += "${LAYERDIR}/recipes-*/*/*.bb \
	${LAYERDIR}/recipes-*/*/*.bbappend"

BBFILE_COLLECTIONS += "mender-raspberrypi"
BBFILE_PATTERN_mender-raspberrypi = "^${LAYERDIR}/"
BBFILE_PRIORITY_mender-raspberrypi = "10"

LAYERDEPENDS_mender-raspberrypi = "mender raspberrypi"

# Recommended for u-boot support for raspberrypi5
# https://git.yoctoproject.org/meta-lts-mixins 'scarthgap/u-boot' branch
LAYERRECOMMENDS_mender-raspberrypi = "lts-u-boot-mixin"

LAYERSERIES_COMPAT_mender-raspberrypi = "kirkstone langdale mickledore scarthgap"

# Raspberry Pi doesn't work with GRUB currently.
_MENDER_IMAGE_TYPE_DEFAULT:rpi = "mender-image-sd"
_MENDER_BOOTLOADER_DEFAULT:rpi = "mender-uboot"
```

## meta-mender-selftest/conf/layer.conf
```bitbake
# Layer configuration for meta-mender
# Copyright 2016 Mender Software AS

# We have a conf and classes directory, add to BBPATH
BBPATH .= ":${LAYERDIR}"

# We have recipes-* directories, add to BBFILES
BBFILES += "${LAYERDIR}/recipes-*/*/*.bb \
	${LAYERDIR}/recipes-*/*/*.bbappend"

BBFILE_COLLECTIONS += "mender-selftest"
BBFILE_PATTERN_mender-selftest = "^${LAYERDIR}/"
BBFILE_PRIORITY_mender-selftest = "6"
```

## meta-mender-toradex-nxp/conf/layer.conf
```bitbake
# Board specific layer configuration for meta-mender
# Copyright 2016 Mirza Krak

# We have a conf and classes directory, add to BBPATH
BBPATH .= ":${LAYERDIR}"

# We have recipes-* directories, add to BBFILES
BBFILES += "${LAYERDIR}/recipes-*/*/*.bb \
	${LAYERDIR}/recipes-*/*/*.bbappend"

BBFILE_COLLECTIONS += "mender-toradex-nxp"
BBFILE_PATTERN_mender-toradex-nxp = "^${LAYERDIR}/"
BBFILE_PRIORITY_mender-toradex-nxp = "91"
```

## meta-mender-toradex-nxp/conf/machine/colibri-imx7-mender.conf
```bitbake
#@TYPE: Machine
#@NAME: Toradex Colibri iMX7D/S with Mender integration
#@SOC: i.MX 7Dual / i.MX 7Solo
#@DESCRIPTION: Machine configuration for Toradex Colibri iMX7 SOM with Mender integration

require conf/machine/colibri-imx7.conf

MACHINEOVERRIDES =. "colibri-imx7:"

# MTD partitioning defined for colibri_imx7:
#
MENDER_MTDIDS = "nand0=gpmi-nand"
MENDER_MTDPARTS = "gpmi-nand:512k(mx7-bcb),1536k(u-boot1)ro,1536k(u-boot2)ro,512k(u-boot-env),-(ubi)"

# 512MB of NAND flash
MENDER_STORAGE_TOTAL_SIZE_MB = "512"
# 16MB for data partition
MENDER_DATA_PART_SIZE_MB = "16"
# align to PEB size 128k
MENDER_STORAGE_PEB_SIZE = "131072"
# Account for UBI overhead, see
# http://www.linux-mtd.infradead.org/doc/ubi.html#L_overhead for details,
MENDER_PARTITIONING_OVERHEAD_KB = "2048"
# all of above should give ~244MB for rootfs

# make sure that kernel and devicetree are installed
MACHINE_ESSENTIAL_EXTRA_RDEPENDS = "kernel-image kernel-devicetree"
MACHINE_ESSENTIAL_EXTRA_RRECOMMENDS += "mtd-utils mtd-utils-ubifs"
```

## tests/meta-mender-beaglebone-ci/conf/layer.conf
```bitbake
# We have a conf and classes directory, add to BBPATH
BBPATH .= ":${LAYERDIR}"

# We have recipes-* directories, add to BBFILES
BBFILES += "${LAYERDIR}/recipes-*/*/*.bb \
	${LAYERDIR}/recipes-*/*/*.bbappend"

BBFILE_COLLECTIONS += "meta-mender-beaglebone-ci"
BBFILE_PATTERN_meta-mender-beaglebone-ci = "^${LAYERDIR}/"
BBFILE_PRIORITY_meta-mender-beaglebone-ci = "99"
```

## tests/meta-mender-beaglebone-ci/conf/machine/beaglebone-mender.conf
```bitbake
#@TYPE: Machine
#@NAME: Beaglebone machine - Mender CI test host
#@DESCRIPTION: Machine configuration for Beaglebone Black as Mender test host

require conf/machine/beaglebone.conf

MACHINEOVERRIDES =. "beaglebone:"

KMACHINE = "beaglebone"
```
