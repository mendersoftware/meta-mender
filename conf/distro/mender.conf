## tests/meta-mender-beaglebone-yocto-ci/conf/layer.conf
```bitbake
# We have a conf and classes directory, add to BBPATH
BBPATH .= ":${LAYERDIR}"

# We have recipes-* directories, add to BBFILES
BBFILES += "${LAYERDIR}/recipes-*/*/*.bb \
	${LAYERDIR}/recipes-*/*/*.bbappend"

BBFILE_COLLECTIONS += "meta-mender-beaglebone-yocto-ci"
BBFILE_PATTERN_meta-mender-beaglebone-yocto-ci = "^${LAYERDIR}/"
BBFILE_PRIORITY_meta-mender-beaglebone-yocto-ci = "99"

LAYERSERIES_COMPAT_meta-mender-beaglebone-yocto-ci = "zeus"
```
