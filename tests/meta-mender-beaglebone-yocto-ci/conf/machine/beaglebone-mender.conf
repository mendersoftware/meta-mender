## tests/meta-mender-beaglebone-yocto-ci/conf/machine/beaglebone-mender.conf
```bitbake
#@TYPE: Machine
#@NAME: Beaglebone machine - Mender CI test host
#@DESCRIPTION: Machine configuration for Beaglebone Black as Mender test host

require conf/machine/beaglebone-yocto.conf

MACHINEOVERRIDES =. "beaglebone-yocto:"

KMACHINE = "beaglebone-yocto"
```

## tests/meta-mender-ci/conf/distro/poky-mender-ci.conf
```bitbake
require conf/distro/poky.conf

DISTRO = "poky-mender-ci"

DISTRO_NAME = "Poky (Yocto Project Reference Distro) with Mender CI enhancements"

# disable features that are not needed for QA
DISTRO_FEATURES_remove = "alsa bluetooth irda x11 3g nfc bluez5 opengl wayland pulseaudio"
```

## tests/meta-mender-ci/conf/layer.conf
```bitbake
# We have a conf and classes directory, add to BBPATH
BBPATH .= ":${LAYERDIR}"

# We have recipes-* directories, add to BBFILES
BBFILES += "${LAYERDIR}/recipes-*/*/*.bb \
	${LAYERDIR}/recipes-*/*/*.bbappend"

BBFILE_COLLECTIONS += "mender-ci"
BBFILE_PATTERN_mender-ci = "^${LAYERDIR}/"
BBFILE_PRIORITY_mender-ci = "10"

LAYERSERIES_COMPAT_mender-ci = "walnascar"

IMAGE_FEATURES:append = " \
    read-only-rootfs \
    ssh-server-openssh \
"
IMAGE_INSTALL:append = "\
    lsb-test \
    ${MENDER_MOCK_SERVER} \
    ${DBUS_WEBSOCKETS_TEST} \
"

MENDER_MOCK_SERVER = "mender-mock-server"
# There isn't enough space to install this on vexpress-qemu-flash.
MENDER_MOCK_SERVER:vexpress-qemu-flash = ""

DBUS_WEBSOCKETS_TEST = "python3-profile python3-websockets python3-pydbus"
# There isn't enough space to install this on vexpress-qemu-flash.
DBUS_WEBSOCKETS_TEST:vexpress-qemu-flash = ""

LAYERDEPENDS_mender-ci:append = " mender"

IMAGE_CLASSES += "extrausers"
EXTRA_USERS_PARAMS = "\
    useradd -p '' mender-ci-tester; \
"
```

## tests/meta-mender-raspberrypi3-ci/conf/layer.conf
```bitbake
# We have a conf and classes directory, add to BBPATH
BBPATH .= ":${LAYERDIR}"

# We have recipes-* directories, add to BBFILES
BBFILES += "${LAYERDIR}/recipes-*/*/*.bb \
	${LAYERDIR}/recipes-*/*/*.bbappend"

BBFILE_COLLECTIONS += "meta-mender-raspberrypi3-ci"
BBFILE_PATTERN_meta-mender-raspberrypi3-ci = "^${LAYERDIR}/"
BBFILE_PRIORITY_meta-mender-raspberrypi3-ci = "99"

IMAGE_BOOT_FILES_append = " boot-for-flashing.scr"

LAYERSERIES_COMPAT_meta-mender-raspberrypi3-ci = "zeus"
```

## tests/meta-mender-raspberrypi3-ci/conf/machine/raspberrypi3-mender.conf
```bitbake
#@TYPE: Machine
#@NAME: RPi3 machine - Mender CI test host
#@DESCRIPTION: Machine configuration for Rpi3 as Mender test host
require conf/machine/raspberrypi3.conf

MACHINEOVERRIDES =. "raspberrypi3:"
KMACHINE = "raspberrypi3"
```

## tests/meta-mender-toradex-nxp-ci/conf/machine/colibri-imx7-mender.conf
```bitbake
#@TYPE: Machine
#@NAME: Toradex Colibri iMX7D/S with Mender integration
#@SOC: i.MX 7Dual / i.MX 7Solo
#@DESCRIPTION: Machine configuration for Toradex Colibri iMX7 SOM with Mender integration

require conf/machine/colibri-imx7.conf

MACHINEOVERRIDES =. "colibri-imx7:"

# MTD partitioning defined for colibri_imx7:
#
# #define MTDPARTS_DEFAULT	"mtdparts=gpmi-nand:"		\
# 				"512k(mx7-bcb),"		\
# 				"1536k(u-boot1)ro,"		\
# 				"1536k(u-boot2)ro,"		\
# 				"512k(u-boot-env),"		\
# 				"-(ubi)"

# 512MB of NAND flash
MENDER_STORAGE_TOTAL_SIZE_MB = "512"
# 512kB for iMX BCB, 2*1.5 MB for uboot and additional 512kB for uboot env, pretend it's a
# single boot partition
MENDER_BOOT_PART_SIZE_MB = "4"
# 16MB for data partition
MENDER_DATA_PART_SIZE_MB = "16"
# align to PEB size 128k
MENDER_PARTITION_ALIGNMENT_KB = "128"
# there is no partitioning overhead (no MBR and such)
MENDER_PARTITIONING_OVERHEAD_KB = "0"
# Account for UBI overhead, see
# http://www.linux-mtd.infradead.org/doc/ubi.html#L_overhead for details,
MENDER_STORAGE_RESERVED_RAW_SPACE = "20971520"
# all of above should give ~244MB for rootfs

# since UBIFS employs compression, we override maximum rootfs size and put the
# upper limit at 300MB
IMAGE_ROOTFS_MAXSIZE = "307200"

# NOTE: this affects only u-boot's autoconfigured headers, the same variable is
# also used for generating fw_env.config but because of assumptions made in
# meta-mender-core/recipes-bsp/u-boot/u-boot-fw-utils-mender.inc we need ship
# our own config instead.
MENDER_UBOOT_ENV_STORAGE_DEVICE_OFFSET = "0x380000"
# board configuration is set up with CONFIG_ENV_RANGE = 2 * CONFIG_ENV_SIZE,
# hence we need to override the offset of redundant environment otherwise the
# default value (as calculated by u-boot-mender-common.inc) would end up inside
# the backup space of the main environment
MENDER_UBOOT_ENV_STORAGE_DEVICE_OFFSET_1 = "${MENDER_UBOOT_ENV_STORAGE_DEVICE_OFFSET}"
MENDER_UBOOT_ENV_STORAGE_DEVICE_OFFSET_2 = "0x3c0000"

# make sure that kernel and devicetree are installed
MACHINE_ESSENTIAL_EXTRA_RDEPENDS = "kernel-image kernel-devicetree"
MACHINE_ESSENTIAL_EXTRA_RRECOMMENDS += "mtd-utils mtd-utils-ubifs"

# pick u-boot-toradex-fsl-fw-utils as provider of fw_{printenv,setenv}
PREFERRED_PROVIDER_u-boot-fw-utils ?= "u-boot-toradex-fsl-fw-utils"
```
